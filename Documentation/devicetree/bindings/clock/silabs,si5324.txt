## Documentation/devicetree/bindings/media/xilinx/xlnx,v-scaler-hls-8.1.txt
```
Xilinx Scaler (SCALER)
------------------------------------

Required properties:

- compatible: Must be "xlnx,v-scaler-hls-8.1".

- reg: Physical base address and length of the registers set for the device.

- clocks: Reference to the video core clock.

- xlnx,num-hori-taps, xlnx,num-vert-taps: The number of horizontal and vertical
  taps for scaling filter(range: 6,8,10,12).

- xlnx,max-num-phases: The maximum number of phases for scaling filter
  (Only allowed is 64).

- xlnx,max-num-lines : The maxiumum number of lines for the scaler
 (For this IP the values is 2160)

- xlnx,max-pixels : The maxium number of pixes on a line
 (For this IP the value is 3840)
 
- xlnx,pix-per-clk : The pixels per clock property of the IP
 (Currently only 1 pixel per clock and 2 pixel per clock is supported)

- reset-gpios: Specifier for a GPIO that assert for VPSS Scaler reset.
  This property is mandatory for the Scaler

- ports: Video ports, using the DT bindings defined in ../video-interfaces.txt.
  The scaler has an input port (0) and an output port (1).


Required port properties:

- xlnx,video-format: Must be one of RBG, YUV_444 or YUV_422 for
  both input port (0) and YUV_422 for output port (1).

- xlnx,video-width: Video width as defined in video.txt

Example:

	scalar_1:scalar@a0000000 {
		compatible = "xlnx,v-scaler-hls-8.1";
		reg = <0x0 0xa0000000 0x0 0x40000>;
		clocks = <&vid_stream_clk>;
		xlnx,num-hori-taps = <8>;
                xlnx,num-vert-taps = <8>;
                xlnx,max-num-phases = <64>;
                xlnx,max-lines = <2160>;
                xlnx,max-pixels = <3840>;
                xlnx,pix-per-clk = <2>;
		reset-gpios = <&gpio 87 1>;

		ports {
                        #address-cells = <1>;
                        #size-cells = <0>;

                        port@0 {
                                reg = <0>;

                                xlnx,video-format = <XVIP_VF_RBG>;
                                xlnx,video-width = <8>;

                                scalar_in: endpoint {
                                        remote-endpoint = <&csc_out>;
                                };
                        };
                        /*
                         * Do not change this 
                         * Reason being VDMA supports only YUV 422
                         */
                        port@1 {
                                reg = <1>;

                                xlnx,video-format = <XVIP_VF_YUV_422>;
                                xlnx,video-width = <8>;

                                scalar_out: endpoint {
                                        remote-endpoint = <&vcap_tpg_in>;
                                };
                        };
                };

	};
```

## Documentation/devicetree/bindings/media/xilinx/xlnx,v-vpss-csc-only.txt
```
Xilinx VPSS Color Space Converter (CSC)
-----------------------------------------
The Xilinx VPSS Color Space Converter (CSC) is a Video IP that currently supports
color space conversion from RGB input to RGB or YUV 444 output. No other input or
output formats are supported.

The V4L2 subdevice driver exposes a control interface to manipulate user controls
like brightness, saturation, contrast, red gain, blue gain and green gain. Currently,
only BT 709 standard is supported on the output side.

Required properties:

- compatible: Must be "xlnx,v-vpss-csc-only".

- reg: Physical base address and length of the registers set for the device.

- clocks: Reference to the video core clock.

- ports: Video ports, using the DT bindings defined in ../video-interfaces.txt.
  The scaler has an input port (0) and an output port (1).


Required port properties:

- xlnx,video-format: Must be one of RBG only for
  input port (0) and RBG or YUV444 for output port (1).

- xlnx,video-width: Video width as defined in video.txt

Example:
	csc_1:csc@0xa0040000 {
		compatible = "xlnx,v-vpss-csc-only";
		reg = <0x0 0xa0040000 0x0 0x10000>;
		clocks = <&vid_stream_clk>;

		ports {
                        #address-cells = <1>;
                        #size-cells = <0>;

                        port@0 {
                                reg = <0>;

                                xlnx,video-format = <XVIP_VF_RBG>;
                                xlnx,video-width = <8>;

                                csc_in: endpoint {
                                        remote-endpoint = <&gamma_out>;
                                };
                        };
                        port@1 {
                                reg = <1>;

                                xlnx,video-format = <XVIP_VF_RBG>;
                                xlnx,video-width = <8>;

                                csc_out: endpoint {
                                        remote-endpoint = <&scalar_in>;
                                };
                        };
                };

	};
```

## Documentation/devicetree/bindings/media/xilinx/xlnx,vphy.txt
```
Xilinx VPHY (Early Access Release)

The Xilinx Video PHY is a video-specific wrapper around different versions of the GT PHY. The
corresponding driver is phy/phy-xilinx-vphy.

It is tightly coupled with its current sole user HDMI RXSS, see xlnx,v-hdmirxss.txt

The main configuration is currently fixed and built-in the driver, only the resource address and
interrupt are configurable here.

At least one lane reference must be made (by HDMI RX) to get a handle to the vphy driver. The
(currently 4) arguments are not used and subject to change or removal. The vphy reference
is subject to change.

	vphy: vphy@a0000000 {
		compatible = "xlnx,vphy-1.1";
		reg = <0x0 0xa0000000 0x10000>;
		interrupts = <0 92 4>;
		interrupt-parent = <&gic>;
		vphy_lane0: vphy_lane@0 {
			#phy-cells = <4>;
		};
		vphy_lane1: vphy_lane@1 {
			#phy-cells = <4>;
		};
		vphy_lane2: vphy_lane@2 {
			#phy-cells = <4>;
		};
		vphy_lane3: vphy_lane@3 {
			#phy-cells = <4>;
		};
	};
```

## Documentation/devicetree/bindings/phy/xlnx,vphy.txt
```
Xilinx VPHY (Staging)

The Xilinx Video PHY is a high-level video-specific wrapper around
different versions of the GT PHY. Its driver is phy/phy-xilinx-vphy.c

It offers the PHY driver interface as well as higher-level video
specific support functions.

Its current users are Xilinx HDMI RX/TX SS.
(See xlnx,v-hdmi-rx-ss.txt and xlnx,v-hdmi-tx-ss.txt)

Required properties (port (child) nodes):
lane0:
- #phy-cells	: Should be 4
		  Cell after port phandle is device type from:
			- <controller_type controller_instance is_shared direction_tx>

controller_type = 0 for HDMI
controller_instance = [0, ...] indexes the instance of the protocol controller
is_shared = 1 if the RX and TX can be shared across the same protocol/controller
direction_tx = 0 for RX and 1 for TX

(These properties are intended for future steering of multiple protocols sharing VPHYs,
and are therefore subject to change.)

An example is, with comments for work-in-progress (TODO):

	vphy: vphy@a0000000 {
		compatible = "xlnx,vphy-1.1";
		reg = <0x0 0xa0000000 0x10000>;
		interrupts = <0 92 4>;
		interrupt-parent = <&gic>;

		clocks = <&vid_s_axi_clk>;
		clock-names = "axi-lite";

		/* these are created by the device tree generator */
		/* these are required and handled in the driver */
		xlnx,input-pixels-per-clock = <0x2>;
		xlnx,nidru = <0x1>;
		xlnx,nidru-refclk-sel = <0x4>;
		xlnx,rx-no-of-channels = <0x3>;
		xlnx,rx-pll-selection = <0x0>;
		xlnx,rx-protocol = <0x1>;
		xlnx,rx-refclk-sel = <0x1>;
		xlnx,tx-no-of-channels = <0x3>;
		xlnx,tx-pll-selection = <0x6>;
		xlnx,tx-protocol = <0x1>;
		xlnx,tx-refclk-sel = <0x0>;
		xlnx,hdmi-fast-switch = <0x1>;

		/* @TODO these are NOT yet created by the device tree generator */
		/* these are not not required by the driver, but are used if present */
		/* (!!) if not present here, they get a hard-coded value in the driver (!!) */
		xlnx,transceiver-type = <0x5>;
		xlnx,tx-buffer-bypass = <0x1>;

		vphy_lane0: vphy_lane@0 {
			#phy-cells = <4>;
		};
		vphy_lane1: vphy_lane@1 {
			#phy-cells = <4>;
		};
		vphy_lane2: vphy_lane@2 {
			#phy-cells = <4>;
		};
		vphy_lane3: vphy_lane@3 {
			#phy-cells = <4>;
		};
	};
```
