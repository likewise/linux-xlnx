## Documentation/devicetree/bindings/clock/silabs,si5324.txt
```
Binding for Silicon Labs Si5324 programmable I2C clock generator.

Reference
[1] Si5324 Data Sheet
    http://www.silabs.com/Support%20Documents/TechnicalDocs/Si5324.pdf

The Si5324 is a programmable I2C clock generator with 2 input clocks. The
2nd input clock can be switched between a clock input or an external fixed-
frequency crystal, thus 3 input options are present. It can drive two
output clocks.

The internal structure of the clock generator can be found in [1].

==Incomplete driver==

The current driver is incomplete. It can currently be used to generate a
free-running clock, based on xtal input, and driving output clock 0. It
implements the rate_set method. The device tree configuration must conform
to these limitations, see the example below.

==I2C device node==

Required properties:
- compatible: shall be "silabs,si5324".
- reg: i2c device address, shall be 0x68.
- #clock-cells: from common clock binding; shall be set to 1.
- clocks: from common clock binding; list of parent clock
  handles, shall be xtal reference clock or clkin1 or clkin2.
- #address-cells: shall be set to 1.
- #size-cells: shall be set to 0.

==Child nodes==

Each of the two clock outputs can be overwritten individually by
using a child node to the I2C device node. If a child node for a clock
output is not set, the eeprom configuration is not overwritten.

Required child node properties:
- reg: number of clock output.

==Example==

/* 114.285MHz reference crystal */
refclk: refclk {
	compatible = "fixed-clock";
	#clock-cells = <0>;
	clock-frequency = <114285000>;
};

i2c-master-node {
	/* Si5324 i2c clock generator */
	si5324: clock-generator@68 {
		status = "okay";
		compatible = "silabs,si5324";
		reg = <0x68>;
		#address-cells = <1>;
		#size-cells = <0>;
		#clock-cells = <1>;

		/* input clock(s) */
		clocks = <&refclk>;
		clock-names = "xtal";

		/* output clocks */
		clk0 {
			reg = <0>;
			/* initial output frequency */
			clock-frequency = <114285000>;
		};
		/* this Si5324 output is not connected on the ZCU102 board
		clk1 {
			reg = <1>;
		};
		*/
	};
};
```

## Documentation/devicetree/bindings/drm/xilinx/xlnx,v-hdmi-tx-ss.txt
```
Xilinx HDMI TX Subsystem (Staging)

The Xilinx HDMI TX Subsystem contains several subcores to implement
a HDMI receiver. staging/xilinx/hdmi/xilinx_drm_hdmi.c implements a
DRM/KMS driver that slaves to xilinx_drm_drv.c in the output pipeline.

If xlnx,vtc-offset is given it specifies the offset of the built-in
VTC IP block. This is required.

Refer to xlnx,vphy.txt for the phy specifics.

retimer-clk is optional. If specified, the corresponding driver
should offer a CCF clock that supports .set_rate(). Through this,
the device can retime/redrive the HDMI TX signal on the connector
depending on the TX clock line rate.

All properties are required.

The "retimer-clk" is optional. If present, it is notified of TX link
clock changes through set_rate(). Tested with dp159.c driver.

phy-names must be hdmi-phy0 etc.

	hdmi_txss: hdmi_txss@a0060000 {
		compatible = "xlnx,v-hdmi-tx-ss-2.0";
		reg = <0x0 0xa0060000 0x0 0x20000>;
		interrupts = <0 93 4>;
		interrupt-parent = <&gic>;

		clocks = <&vid_s_axi_clk>, <&vid_stream_clk>, <&dp159>;
		clock-names = "axi-lite", "video", "retimer-clk";

		phy-names = "hdmi-phy2";
		phys = <&vphy_lane2 0 1 1 125000000>;

		/* these are created by the device tree generator (DTG) */
		xlnx,input-pixels-per-clock = <0x2>;
		xlnx,max-bits-per-component = <0x8>;

		/* not yet standardized or created by the DTG */
		/* required offset of VTC within reg */
		xlnx,vtc-offset = <0x10000>;

		/* not yet standardized or created by the DTG */
		/* required offset of VTC within reg */
		xlnx,pixel-format = "argb8888";
	};
```

## Documentation/devicetree/bindings/drm/xilinx/xv_mixer.txt
```
Device Tree Bindings for Xilinx Video Mixer IP core

Required properties for Core IP Node:

    Required General Properties:
    - compatible: "xlnx,video_mixer-1.00a"

    - reg: MMIO base address and size of the Xilinx Video Mixer IP core address 
           space

    - interrupts-parent: Phandle for interrupt controller

    - interrupts: Interrupt number

    Required Mixer IP Core Properties
    - xlnx,bpc [number]: The data width per video component (8,10,12,16) Note:
	only 8 is currently supported

    - xlnx,num-layers [number]: Number of active overlay layers supported (1-7)
	(does not include logo layer but does include base layer)

    Optional Mixer IP Core Properties:
    - xlnx,logo-layer: Boolean indicating that logo layer is enabled

Layer Sub Node Properties:
    The device tree will need to include a sub node for each enabled layer
    in the IP core that is to be utilized by the driver.
    These layer nodes describe the base layer as well as each overlay layer 
    but not the logo layer (see Logo Layer Properties below).
    Each layer node should be named using "layer_#" format (e.g.
	layer_0 { }; layer_1 {}; ...)

    Required Properties:
    - xlnx,layer-id [number]: Mixer layer number; should correspond to layer
	number in the IP (e.g.  layer_1 should use xlnx,layer_id = <1).  Node
	Layer_0 is the only required node (exception: if xlnx,logo-layer
	property exists, then a logo {}; node must be present).  Layer_0 will
	be interpreted as the background layer and must use layer-id = <0>.

    - xlnx,vformat [string]: Expected layer input data format. 
	For streaming layers, the possible formats are: "rgb", "yuv444", 
		"yuv422", "yuv420"
	For memory layers, the possible formats are: "rgba8", "y_uv8", 
		"y_uv8_420", "yuyv8"

    - xlnx,layer-height [number]: Only required for layer_0 node (master layer).
	Indicates maximum vertical size of active screen display in pixels

    Optional Properties:
    - xlnx,layer-alpha: Indicates that this layer supports global alpha blending

    - xlnx,layer-scale: Indicates that this layer supports mixer scaling. Not
	applicable to layer_0 (i.e. master) node.

    - xlnx,layer-width [number]: Required if xlnx,layer-scale property exists
	for layer.  Indicates maximum number of columns (before scaling) for
	this layer (i.e. horizontal pixels)

    - xlnx,layer-streaming: Layer obtains data as video stream (if omitted,
	layer is presumed to be memory mapped)


Logo Layer Sub Node Properties:
    This node is only required if the core IP node contains the 
    'xlnx,logo-layer' property indicating the the core supports a logo layer.
    This subnode should be labled "logo" (e.g. logo { }; ).

    Required Properties:	
    - xlnx,layer-id [number]: This should be set to <8>.

    - xlnx,logo-height [number]: Maximum number of vertical pixels for the logo
	layer

    - xlnx,logo-width [number]: Maximum number of horizontal pixels for the logo
	layer


    Optional Properties:
    - xlnx,logo-transp: Logo support color key transparency feature

    - xlnx,logo-pixel-alpha: Logo supports per pixel alpha data (e.g. RGBA).


Additional Nodes Requiring Modificaton

There must exist a xilinx_drm node in the dts which much be updated as follows:

    Required Properties for xilinx_drm Node:

    - xlnx,mixer: Phandle reference to mixer IP node

    - xlnx,mixer-reset-gpios: Should include a phandle reference to
	the gpio controller with the proper gpio id and level (mixer reset
	default should be set to "low")


    Required Properties for each xilinx_drm plane# Node:

    Each plane node served by a mixer layer should include the
    the following property:

    - xlnx,mixer-layer: A phandle reference to the mixer layer node serving
	this plane. 



Example:

This sample is of a mixer IP core that has two overlay layers enabled in
addition to the logo layer.  One overlay 1 is a streaming video input layer
which is served by a dma IP core and overlay 2 is memory-based
(i.e. dma-driven) layer (no need for a separate dma IP core). Additionally, the 
mixer's reset line is on gpio #79. 

v_mix_0: v_mix@80040000 {
	compatible = "xlnx,v-mix-1.00a";
	interrupt-parent = <&gic>;
	interrupts = <0 90 4>;
	reg = <0x0 0x80040000 0x0 0x40000>;

	xlnx,bpc = <8>;
	xlnx,num-layers = <3>;
	xlnx,logo-layer;

	mixer_master_layer: layer_0 {
		xlnx,layer-id = <0>;
		xlnx,vformat = "rgb";
		xlnx,layer-width = <1920>;
		xlnx,layer-height = <1080>;
	};

	mixer_overlay_1: layer_1 {
		xlnx,layer-id = <1>;
		xlnx,vformat = "yuv422";
		xlnx,layer-streaming;
		xlnx,layer-alpha;
	};

	mixer_overlay_2: layer_2 {
		xlnx,layer-id = <2>;
		xlnx,vformat = "y_uv8_420";
		xlnx,layer-scale;
		xlnx,layer-width = <1920>;
	};

	mixer_logo: logo {
		xlnx,layer-id = <8>;
		xlnx,logo-width = <64>;	
		xlnx,logo-height = <64>;	
	};
};



xilinx_drm: xilinx_drm {
	compatible = "xlnx,drm";
	status = "okay";

	/* mixer IP specific additions to this node */
	xlnx,mixer = <&v_mix_0>;
	xlnx,mixer-reset-gpios = <&gpio 79 1>;

	xlnx,vtc = <&v_tc_0>;
	xlnx,encoder-slave = <&adv7511>;
	xlnx,connector-type = "HDMIA";
	planes {
		xlnx,pixel-format = "rgb888";
		plane0 {
			dmas = <&vdma_0 0>;
			dma-names = "dma0";
			xlnx,mixer-layer = <&mixer_master_layer>;
		};
		plane1 {
			dmas = <&vdma_1 0>;
			dma-names = "dma0";
			xlnx,mixer-layer = <&mixer_overlay_1>;
		};
		plane2 {
			xlnx,mixer-layer = <&mixer_overlay_2>;
		};
		plane3 {
			xlnx,mixer-layer = <&mixer_logo>;
		};
	};
};
```

## Documentation/devicetree/bindings/media/i2c/dp159.txt
```
* Texas Instruments dp159 redriver/retimer

The dp159 device is a redriver/retimer found driving DP/HDMI links.

Required Properties :
- compatible : value must be "ti,dp159"

Note:
- reg can be 0x5e (instead of 0x2c) for the Engineering Sample,
  the driver will then steer this device differently

Example:

	i2c0@1c22000 {
		...
		...
		dp159@2c {
			compatible = "ti,dp159";
			reg = <0x2c>;
		};
		...
	};
```

## Documentation/devicetree/bindings/media/xilinx/xlnx,v-demosaic-v1.0.txt
```
Xilinx HLS Video Demosaic IP
------------------------------------------------
The Xilinx HLS Video Demosaic IP is used to interface to a Bayer source.
It can convert 8-bit Bayer formats to 24 bit RGB format. Currently, the 
driver supports only the following configurations :
	- 8 bit, High Quality Interpolation
	- No zipper
All other configurations are not supported. Has been tested with kernel 4.6
and 1PPC designs.

The driver does not look at individual GPIO resets from the device tree.
It will be updated in a future update to this driver.

Required properties:

- compatible: Must be "xlnx,v-demosaic-v1.0".

- reg: Physical base address and length of the registers set for the device.

- clocks: Reference to the video core clock.
 
- ports: Video ports, using the DT bindings defined in ../video-interfaces.txt.
  The scaler has an input port (0) and an output port (1).


Required port properties:

- xlnx,video-format: Must be one of RBG, YUV_422, YUV_422 or YUV_420 for
  both input port (0) and output port (1).

- xlnx,video-width: Video width as defined in video.txt


Example :

demosaic_1: demosaic@0xA00B0000 {
		compatible = "xlnx,v-demosaic-v1.0";
		reg = <0x0 0xa00b0000 0x0 0x10000>;
		clocks = <&vid_stream_clk>;
		ports {
			#address-cells = <1>;
			#size-cells = <0>;

			port@0 {
				reg = <0>;
				xlnx,video-format = <XVIP_VF_MONO_SENSOR>;
				xlnx,video-width = <8>;
				
				demosaic_in: endpoint {
					remote-endpoint = <&tpg_out>;
				};
			};

			port@1 {
				reg = <1>;
				xlnx,video-format = <XVIP_VF_RBG>;
				xlnx,video-width = <8>;

				demosaic_out: endpoint {
					remote-endpoint = <&gamma_in>;
				};
			};
		};
	};
```

## Documentation/devicetree/bindings/media/xilinx/xlnx,v-hdmi-rx-ss.txt
```
Xilinx HDMI RX Subsystem (Staging)

The Xilinx HDMI RX Subsystem contains several subcores to implement
a HDMI receiver. media/platform/xilinx/xilinx-hdmi-rx.c implements a
V4L2 video-capture sub-device for the Xilinx Video IP Pipeline device
(xilinx-vipp).

Refer to xlnx,vphy.txt for the phy specifics.

phy-names must be hdmi-phy0 etc.

	hdmi_rxss: hdmi_rxss@a1000000 {
		compatible = "xlnx,v-hdmi-rx-ss-2.0";
		reg = <0x0 0xa1000000 0x10000>;
		interrupts = <0 91 4>;
		interrupt-parent = <&gic>;

		clocks = <&vid_s_axi_clk>, <&vid_stream_clk>;
		clock-names = "axi-lite", "video";

		phy-names = "hdmi-phy0", "hdmi-phy1", "hdmi-phy2";
		phys = <&vphy_lane0 0 1 1 0>, <&vphy_lane1 0 1 1 0>, <&vphy_lane2 0 1 1 0>;

		/* these are handled in the driver */
		/* these are created by the device tree generator */
		xlnx,input-pixels-per-clock = <0x2>;
		xlnx,max-bits-per-component = <0x8>;

		xlnx,hdcp22-rx-offset = <0x40000>;
		/* relative to xlnx,hdcp22-tx-offset */
		xlnx,hdcp22-cipher-offset = <0x00000>;
		xlnx,hdcp22-timer-offset = <0x10000>;
		xlnx,hdcp22-rng-offset = <0x20000>;

		xlnx,hdcp1x-timer-offset = <0x00000>;
		xlnx,hdcp1x-offset = <0x80000>;
	};
```

## Documentation/devicetree/bindings/media/xilinx/xlnx,v-hdmirxss.txt
```
Xilinx HDMI RX Subsystem (Early Access Release)

The Xilinx HDMI RX Subsystem contains several subcores to implement a HDMI receiver. The Linux
driver media/platform/xilinx/xilinx-hdmi-rx implements a V4L video-capture sub-device for the
Xilinx Video IP Pipeline device (xilinx-vipp).

The main configuration is currently fixed and built-in the driver, only the resource address and
interrupt and logic clock are configurable here.

The HDMI RXSS is tightly coupled with the Xilinx Video PHY, a video specific wrapper around the GT PHY.

phys is a list of VPHY SerDes lanes used by HDMI RX SS. See xlnx,vphy.txt.

phy-names must be hdmi-phy0 etc.

	hdmi_rxss: hdmi_rxss@a1000000 {
		compatible = "xlnx,v-hdmirxss-2.0";
		reg = <0x0 0xa1000000 0x10000>;
		interrupts = <0 91 4>;
		interrupt-parent = <&gic>;
		clocks = <&vid_stream_clk>;
		phy-names = "hdmi-phy0", "hdmi-phy1", "hdmi-phy2";
		phys = <&vphy_lane0 0 1 1 125000000>, <&vphy_lane1 0 1 1 125000000>, <&vphy_lane2 0 1 1 125000000>;
	};
```
